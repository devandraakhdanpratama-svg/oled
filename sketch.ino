#include <Wire.h>
#include <Adafruit_GFX.h>
#include <Adafruit_SSD1306.h>

#define SCREEN_WIDTH 128
#define SCREEN_HEIGHT 64
#define OLED_RESET     -1
Adafruit_SSD1306 display(SCREEN_WIDTH, SCREEN_HEIGHT, &Wire, OLED_RESET);

// Definisikan Pin Buzzer pada ESP32 (GPIO 18)
#define BUZZER_PIN 18

// --- DEFINISI NADA MUSIK ---
#define NOTE_FS3 185
#define NOTE_G3  196
#define NOTE_A3  220
#define NOTE_B3  247
#define NOTE_C4  262
#define NOTE_D4  294
#define NOTE_E4  330
#define NOTE_FS4 370
#define NOTE_G4  392
#define NOTE_A4  440
#define NOTE_B4  494

// Melodi "Revenge" - XXXTENTACION
int melody[] = {
  NOTE_B3, NOTE_D4, NOTE_FS4, NOTE_B4, 
  NOTE_G3, NOTE_B3, NOTE_D4, NOTE_G4,   
  NOTE_A3, NOTE_C4, NOTE_E4, NOTE_A4,   
  NOTE_FS3, NOTE_A3, NOTE_C4, NOTE_FS4  
};

int noteDuration = 180; // ESP32 bisa memproses lebih cepat, kita buat tempo sedikit lebih pas

int totalNotes = sizeof(melody) / sizeof(int);
int currentNoteIndex = 0;
unsigned long lastNoteTime = 0;

// --- BITMAP STICKMAN MEMAKAI HEADPHONE (48x48) ---
const unsigned char epd_bitmap_headphone1 [] PROGMEM = {
  0x00, 0x00, 0x3f, 0xfc, 0x00, 0x00, 0x00, 0x01, 0xff, 0xff, 0x80, 0x00, 0x00, 0x07, 0xc0, 0x03, 
  0xe0, 0x00, 0x00, 0x0e, 0x00, 0x00, 0x70, 0x00, 0x00, 0x1c, 0x00, 0x00, 0x38, 0x00, 0x00, 0x38, 
  0x00, 0x00, 0x1c, 0x00, 0x00, 0x30, 0x00, 0x00, 0x0c, 0x00, 0x00, 0x70, 0x00, 0x00, 0x0e, 0x00, 
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  0x00, 0x00, 0x01, 0x80, 0x00, 0x00, 0x00, 0x00, 0x01, 0x80, 0x00, 0x00, 0x00, 0x00, 0x00, 0x00, 0x00, 0x00
};

const unsigned char epd_bitmap_headphone2 [] PROGMEM = {
  0x00, 0x00, 0x00, 0x00, 0x00, 0x00, 0x00, 0x00, 0x3f, 0xfc, 0x00, 0x00, 0x00, 0x01, 0xff, 0xff, 
  0x80, 0x00, 0x00, 0x07, 0xc0, 0x03, 0xe0, 0x00, 0x00, 0x0e, 0x00, 0x00, 0x70, 0x00, 0x00, 0x1c, 0x00, 0x00, 0x38, 0x00, 0x00, 0x38, 0x00, 0x00, 0x1c, 0x00, 0x00, 0x30, 0x00, 0x00, 0x0c, 0x00, 
  0x00, 0x70, 0x00, 0x00, 0x0e, 0x00, 0x00, 0x60, 0x00, 0x00, 0x06, 0x00, 0x00, 0xe0, 0x1f, 0xf8, 
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  0x01, 0x80, 0x00, 0x00, 0x00, 0x00, 0x01, 0x80, 0x00, 0x00, 0x00, 0x00, 0x01, 0x80, 0x00, 0x00
};

// Pengaturan Visualizer (Equalizer)
const int numBars = 8;
int barWidth = 5;
int barSpacing = 2;
int visualizerStartX = 70;
int barHeights[numBars];
int targetHeights[numBars];

int headBangState = 0;

void setup() {
  // ESP32 menggunakan pin I2C default (SDA=21, SCL=22)
  Wire.begin(21, 22); 
  
  if(!display.begin(SSD1306_SWITCHCAPVCC, 0x3C)) { 
    for(;;);
  }
  display.clearDisplay();
  
  // Inisialisasi Pin Buzzer
  pinMode(BUZZER_PIN, OUTPUT);
}

void loop() {
  unsigned long currentMillis = millis();

  // --- PEMUTAR MUSIK NON-BLOCKING ---
  if (currentMillis - lastNoteTime >= noteDuration) {
    noTone(BUZZER_PIN); 
    
    int noteFrequency = melody[currentNoteIndex];
    
    // Fungsi tone() pada core ESP32 di Wokwi bekerja sama seperti Arduino
    tone(BUZZER_PIN, noteFrequency, noteDuration - 20);
    
    lastNoteTime = currentMillis;
    headBangState = (headBangState + 1) % 2;

    // Mengatur lompatan visualizer berdasarkan nada
    for (int i = 0; i < numBars; i++) {
      targetHeights[i] = map(noteFrequency, 185, 494, 10, 56) + random(-5, 6);
    }

    currentNoteIndex = (currentNoteIndex + 1) % totalNotes;
  }

  // --- RE-RENDER GRAFIK OLED ---
  display.clearDisplay();

  // 1. Animasi Kepala Mengangguk
  if (headBangState == 0) {
    display.drawBitmap(5, 6, epd_bitmap_headphone1, 48, 48, SSD1306_WHITE);
  } else {
    display.drawBitmap(5, 10, epd_bitmap_headphone2, 48, 48, SSD1306_WHITE);
  }

  // 2. Animasi Audio Equalizer 
  for (int i = 0; i < numBars; i++) {
    // Kecepatan transisi naik turun batang dibuat lebih responsif pada ESP32
    if (barHeights[i] < targetHeights[i]) barHeights[i] += 5;
    if (barHeights[i] > targetHeights[i]) barHeights[i] -= 5;

    barHeights[i] = constrain(barHeights[i], 2, 58);

    int x = visualizerStartX + (i * (barWidth + barSpacing));
    display.fillRect(x, SCREEN_HEIGHT - barHeights[i], barWidth, barHeights[i], SSD1306_WHITE);
  }

  display.display();
  delay(8); // Delay kecil yang dioptimalkan untuk FPS ESP32
}